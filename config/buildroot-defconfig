## config/buildroot-defconfig
```kconfig
# SabakanOS レーンA — Buildroot 設定
# アーキテクチャ: x86_64 / C ライブラリ: musl / 構成: 最小
#
# 使用例 (Buildroot ソースディレクトリで):
#   make BR2_DEFCONFIG=../../config/buildroot-defconfig defconfig
#   make

BR2_x86_64=y
BR2_x86_core2=y
BR2_ARCH="x86_64"
BR2_ENDIAN="LITTLE"
BR2_GCC_TARGET_ARCH="x86-64"
BR2_LARGEFILE=y

# ツールチェイン: Buildroot 製 musl ツールチェイン
BR2_TOOLCHAIN_BUILDROOT=y
BR2_TOOLCHAIN_USES_MUSL=y
BR2_TOOLCHAIN_BUILDROOT_MUSL=y
BR2_TOOLCHAIN_HAS_THREADS=y
BR2_TOOLCHAIN_HAS_THREADS_DEBUG=y
BR2_TOOLCHAIN_HAS_SSP=y
BR2_TOOLCHAIN_HAS_UCONTEXT=y
BR2_TOOLCHAIN_HAS_MMX=y
BR2_TOOLCHAIN_HAS_SYNC=y
BR2_TOOLCHAIN_HAS_C99=y
BR2_TOOLCHAIN_HAS_EXCEPTION=y
BR2_TOOLCHAIN_BUILDROOT_LOCALE=y
BR2_TOOLCHAIN_BUILDROOT_CXX=y

# ベースパッケージ (最小)
BR2_PACKAGE_BUSYBOX=y
BR2_PACKAGE_BUSYBOX_SHOW_OTHERS=y
BR2_PACKAGE_COREUTILS=y
BR2_PACKAGE_DASH=y

# ターゲット: シリアルコンソール経由で getty
BR2_TARGET_GENERIC_GETTY=y
BR2_TARGET_GENERIC_GETTY_PORT="ttyS0"

# ルートFS 形式
BR2_TARGET_ROOTFS_TAR=y
```

## config/kernel-defconfig
```kconfig
# SabakanOS レーンA — Linux カーネル設定
# Linux LTS (x86_64) の defconfig をベースにした最小構成。
# 実際のビルドでは x86_64_defconfig を適用した上で、本ファイルの
# シンボルを olddefconfig で上書き・補完する。
#
# 使用例 (カーネルソースディレクトリで):
#   make ARCH=x86_64 defconfig
#   cat ../../config/kernel-defconfig >> .config
#   make ARCH=x86_64 olddefconfig

CONFIG_X86_64=y
CONFIG_64BIT=y
CONFIG_X86=y
CONFIG_X86_GENERIC=y
CONFIG_X86_INTERNODE_CACHE_SHIFT=6
CONFIG_X86_L1_CACHE_SHIFT=6
CONFIG_X86_TSC=y
CONFIG_X86_CMPXCHG64=y
CONFIG_X86_CMOV=y
CONFIG_X86_MINIMUM_CPU_FAMILY=64
CONFIG_X86_DEBUGCTLMSR=y
CONFIG_PROCESSOR_SELECT=y
CONFIG_CPU_SUP_INTEL=y
CONFIG_CPU_SUP_AMD=y
CONFIG_HPET_TIMER=y
CONFIG_HPET=y

CONFIG_PCI=y
CONFIG_PCI_DOMAINS=y
CONFIG_PCIEPORTBUS=y
CONFIG_PCI_MMCONFIG=y

CONFIG_SERIAL_8250=y
CONFIG_SERIAL_8250_CONSOLE=y
CONFIG_SERIAL_8250_NR_UARTS=4
CONFIG_SERIAL_8250_RUNTIME_UARTS=4

CONFIG_VT=y
CONFIG_VT_CONSOLE=y
CONFIG_VT_CONSOLE_SLEEP=y
CONFIG_HW_CONSOLE=y

CONFIG_BINFMT_ELF=y
CONFIG_BINFMT_SCRIPT=y
CONFIG_COREDUMP=y

CONFIG_PRINTK=y
CONFIG_CONSOLE=y
CONFIG_CONSOLE_SLEEP=y

CONFIG_MODULES=n
CONFIG_BLOCK=y
CONFIG_BLK_DEV_INITRD=y
CONFIG_BLK_DEV_SD=y
CONFIG_ATA=y
CONFIG_ATA_PIIX=y

CONFIG_EXT4_FS=y
CONFIG_PROC_FS=y
CONFIG_SYSFS=y
CONFIG_TMPFS=y

CONFIG_DEVTMPFS=y
CONFIG_DEVTMPFS_MOUNT=y

CONFIG_SMP=y
CONFIG_HZ_250=y
CONFIG_HZ=250

CONFIG_NET=n
```
